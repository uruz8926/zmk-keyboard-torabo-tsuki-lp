## boards/shields/torabo_tsuki_lp/Kconfig.shield
```kconfig
config SHIELD_TORABO_TSUKI_LP_LEFT
    def_bool $(shields_list_contains,torabo_tsuki_lp_left)

config SHIELD_TORABO_TSUKI_LP_RIGHT
    def_bool $(shields_list_contains,torabo_tsuki_lp_right)

# central のときだけ USB HID を有効化
if SHIELD_TORABO_TSUKI_LP_RIGHT
config USB_DEVICE_STACK
    default y
config USB_HID
    default y
config USB_HID_KEYBOARD
    default y
endif

config ZMK_HID_KEYBOARD_REPORT_USAGE
    default 0x07

config ZMK_HID_REPORT_TYPE_NKRO
    default n
```
